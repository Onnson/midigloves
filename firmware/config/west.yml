## firmware/config/west.yml
```yaml
manifest:
  remotes:
    - name: darknao
      url-base: https://github.com/darknao
    - name: stuffmatic
      url-base: https://github.com/stuffmatic
    - name: onnson
      url-base: https://github.com/Onnson

  projects:
    # darknao's ZMK fork with per-layer RGB underglow control.
    # This is the base firmware — we patch it with the small set of hooks
    # under firmware/zmk-fork-patches/ and consume our module through it.
    - name: zmk
      remote: darknao
      revision: rgb-layer-25.08
      import: app/west.yml

    # midigloves firmware module (this repo).
    # For local development, replace this with a west manifest override
    # pointing at your working copy — see firmware/README.md.
    - name: midigloves
      remote: onnson
      revision: main
      path: modules/midigloves

    # USB-MIDI 1.0 class driver for Zephyr's legacy USB device stack.
    # Pulled in when CONFIG_MIDIGLOVES_USB=y. Vetted by a throwaway sample
    # in firmware/samples/usb_midi_test/ before we wire it into the main
    # build — see Milestone 1 of the Device 1.0 plan.
    - name: zephyr-usb-midi
      remote: stuffmatic
      revision: main   # TODO: pin a SHA after Milestone 1.1 passes
      path: modules/lib/zephyr-usb-midi

    # BLE-MIDI GATT service for Zephyr.
    # Pulled in when CONFIG_MIDIGLOVES_BLE=y. Wired up in Milestone 4.
    - name: zephyr-ble-midi
      remote: stuffmatic
      revision: main   # TODO: pin a SHA after Milestone 4 passes
      path: modules/lib/zephyr-ble-midi

  self:
    path: config
```

## firmware/module/Kconfig
```kconfig
# midigloves — Kconfig
#
# Top-level symbol gates the whole module. Sub-symbols enable optional
# transports and features as subsequent milestones land.

menuconfig MIDIGLOVES
    bool "midigloves: Glove80 MIDI instrument"
    help
      Enable the midigloves out-of-tree Zephyr module, which turns the
      Glove80 into a chromatic MIDI instrument with per-key RGB feedback
      that mirrors the active musical scale.

      See https://github.com/Onnson/midigloves for the full design.

if MIDIGLOVES

config MIDIGLOVES_USB
    bool "USB-MIDI transport"
    default y
    help
      Expose the Glove80 as a USB-MIDI 1.0 class device alongside the
      existing HID class. Requires CONFIG_USB_DEVICE_MIDI from the
      stuffmatic/zephyr-usb-midi module.

config MIDIGLOVES_BLE
    bool "BLE-MIDI transport"
    default n
    help
      Expose the Glove80 as a BLE-MIDI GATT peripheral alongside the
      existing HoG service. Requires CONFIG_BLE_MIDI from the
      stuffmatic/zephyr-ble-midi module.

endif # MIDIGLOVES
```

## prototype/firmware/config/west.yml
```yaml
manifest:
  remotes:
    - name: darknao
      url-base: https://github.com/darknao
  projects:
    - name: zmk
      remote: darknao
      revision: rgb-layer-25.08
      import: app/west.yml
  self:
    path: config
```

## prototype/firmware/zmk-patches/new-files/app/dts/bindings/behaviors/zmk,behavior-instrument.yaml
```yaml
description: Instrument mode command behavior

compatible: "zmk,behavior-instrument"

include: two_param.yaml
```
